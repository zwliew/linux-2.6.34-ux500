## arch/arm/mach-u8500/Kconfig
```kconfig
if ARCH_U8500

menu "8500 target platform"

config MACH_U8500_SIMULATOR
	bool "8500 Simulator platform"
	select CPU_V7
	select ARM_GIC
	select SMP
	select MACH_U8500_MOP
	help
		Supports Simulation for u8500 platform

config MACH_U5500_SIMULATOR
	bool "5500(FairBanks) Simulator platform"
	select CPU_V7
	select ARM_GIC
	select SMP
	select MACH_U8500_MOP
	help
		Supports Simulation for u5500(FairBanks) platform

config MACH_U8500_MOP
	bool "MOP500 platform"
	select CPU_V7
	select ARM_GIC
	select SMP
	default y
	help
		Supports MOP500 target board
endmenu

config U8500_CPUIDLE
    tristate "CPUIdle support"
    depends on CPU_IDLE
    select GENERIC_CLOCKEVENTS_BROADCAST
    help
        Add support for CPUIdle for U8500

config U8500_CPUFREQ
    tristate "CPUFreq support"
    depends on CPU_FREQ
    default y
    help
        Add support for CPU Frequency scaling for U8500

config ARCH_HAS_CPU_IDLE_WAIT
    def_bool y

source "arch/arm/mach-u8500/Kconfig-arch"
source "arch/arm/mach-u8500/sim8500_Kconfig"
source "arch/arm/mach-u8500/mop500_Kconfig"

config FORCE_MAX_ZONEORDER
    int "Maximum zone order"
    default "12"

endif
```

## arch/arm/mach-ux500/Kconfig
```kconfig
if ARCH_U8500

config UX500_SOC_DB8500
	bool
	depends on (MACH_U8500_MOP || MACH_U8500_SIMULATOR)
	default y

config UX500_SOC_DB5500
	bool
	default y
	depends on MACH_U5500_SIMULATOR

choice
	prompt "Ux500 target platform"
	default MACH_U8500_MOP

config MACH_U8500_SIMULATOR
	bool "U8500 Simulator (SVP8500)"
	select CPU_V7
	select ARM_GIC
	select SMP
	help
		Supports Simulation for u8500 platform

config MACH_U5500_SIMULATOR
	bool "U5500 Simulator (SVP5500)"
	select CPU_V7
	select ARM_GIC
	select SMP
	help
		Supports Simulation for u5500(FairBanks) platform

config MACH_U8500_MOP
	bool "U8500 MOP500/HREF"
	select CPU_V7
	select ARM_GIC
	select SMP
	help
		Supports MOP500 target board

endchoice

config U8500_CPUIDLE
    tristate "CPUIdle support"
    depends on UX500_SOC_DB8500 && CPU_IDLE
    select GENERIC_CLOCKEVENTS_BROADCAST
    default y
    help
        Add support for CPUIdle for U8500

config U8500_CPUFREQ
    tristate "CPUFreq support"
    depends on UX500_SOC_DB8500 && CPU_FREQ
    default y
    help
        Add support for CPU Frequency scaling for U8500

config U8500_PM
    tristate "PM Support"
    depends on UX500_SOC_DB8500 && PM
    default y
    help
	Add support for PM features for U8500

config ARCH_HAS_CPU_IDLE_WAIT
    def_bool y

config SENSORS1P_MOP
	tristate "HAL and Proximity sensors support"
	depends on GPIO_STMPE2401 || GPIO_TC35892
	default y
	help
		Add support for Osram's SFH7741 Proximity Sensor and Samsumg HED54XXU11 HAL Switch

source "arch/arm/mach-ux500/Kconfig-arch"

config FORCE_MAX_ZONEORDER
    int "Maximum zone order"
    default "12"

config U5500_MLOADER_HELPER
	bool "mLoader helper, mem config from kernel boot args exported to sysfs"
	default n
	depends on MACH_U5500_SIMULATOR
	help
	    Link between boot args and user space program that loads the modem ELF


endif
```

## drivers/als/Kconfig
```kconfig
#
# Ambient Light Sensor sysfs device configuration
#

menuconfig ALS
	tristate "Ambient Light Sensor sysfs device"
	help
	  This framework provides a generic sysfs I/F for Ambient Light
	  Sensor devices.
	  If you want this support, you should say Y or M here.

if ALS

config ALS_BH1780GLI
	tristate "Rohm BH1780GLI light sensor"
	depends on I2C && SYSFS
	help
	  If you say yes here you get support for the
	  Rohm BH1780GLI light sensor.

	  This driver can also be built as a module.
	  If so, the module will be called bh1780gli.

endif #ALS
```

## drivers/misc/ab8500_denc/Kconfig
```kconfig
config AB8500_DENC
	tristate "AB8500_DENC driver support(CVBS)"
	depends on AB8500
	default n
	help
		Please enable this feature if tvout driver support is required.
```

## drivers/misc/shrm/Kconfig
```kconfig
#
# SHM HW kernel configuration
#
config U8500_SHRM
	tristate "U8500 SHRM hardware driver"
	depends on ARCH_U8500
	default Y
	---help---
	  If you say Y here, you will enable the STN8500 SHM hardware driver.

	  If unsure, say N.

config U8500_SHRM_LOOP_BACK
	tristate "U8500 SHRM loopback"
	depends on U8500_SHRM
	default n
	---help---
	  If you say Y here, you will enable the shm loopback

	  If unsure, say N.
```

## drivers/net/caif/Kconfig
```kconfig
#
# CAIF physical drivers
#

if CAIF

comment "CAIF transport drivers"

config CAIF_TTY
	tristate "CAIF TTY transport driver"
	default n
	---help---
	The CAIF TTY transport driver is a Line Discipline (ldisc)
	identified as N_CAIF. When this ldisc is opened from user space
	it will redirect the TTY's traffic into the CAIF stack.

#deprecated-functionality-below

if CAIF_TTY
config CAIF_TTY_NOFCS
	bool "Don't use checksum for CAIF TTY transport driver"
	default n
	---help---
	If the CAIF transport driver is reliable checksumming is
	not needed.
endif # CAIF_TTY


config CAIF_SPI_MASTER
	tristate "CAIF SPI transport driver for master interface"
	default n
	---help---
	The CAIF SPI transport driver. Master SPI interface.

config CAIF_SPI_SLAVE
	tristate "CAIF SPI transport driver for slave interface"
	default n
	---help---
	The CAIF SPI transport driver. Slave SPI interface.

config CAIF_SHM
	tristate "CAIF shared memory transport driver"
	default n
	---help---
	The caif low level driver for the shared memory driver.
	Be aware that if you enable this then you also need to enable a low-level shared memory driver.
        The default is to include the CAIF shared memory loopback driver (for testing).

config CAIF_LOOPBACK
	tristate "CAIF loopback test driver"
	default n
	---help---
	Loopback test driver

if CAIF_SPI_MASTER

comment "CAIF SPI physical drivers"

config CAIF_SPI_LOOP
	tristate "Use simulated SPI loop device"
	default n
	---help---
	Simulated SPI loop device.

endif # CAIF_SPI_MASTER

if CAIF_SPI_SLAVE

config CONFIG_CAIF_SPI_SYNC
	bool "Next command and length in start of frame"
	default n
	---help---
	Putting the next command and length in the start of the frame can
	help to synchronize to the next transfer in case of over or underruns.
	NB: This option also needs to be enabled on the modem.

endif # CAIF_SPI_SLAVE

if CAIF_SHM

comment "CAIF shared memory physical drivers"

config CAIF_SHM_LOOPBACK
	tristate "CAIF shared memory loopback driver"
	default CAIF_USE_SHM
	---help---
	Loopback driver that emulates a real shared memory transport.
	Mainly used for debugging.
	Uses the mailbox interface.

config CAIF_MBXIF
	tristate "CAIF shared mailbox interface"
	default CAIF_SHM
	---help---
	Generic shared mailbox interface

config CAIF_SMBX
	tristate "Use Simulated Mailbox"
	default CAIF_MBXIF
	---help---
	Answer y if you want to use a simulated mailbox interface for the CAIF shared memory transport.
	Mainly used for debugging and as example driver.
	This can also be built as a module.

endif # CAIF_USE_SHM

#deprecated-functionality-above

endif # CAIF
```

## drivers/tee/Kconfig
```kconfig
#
# Copyright (C) ST-Ericsson SA 2010
# Author: Martin Hovang (martin.xm.hovang@stericsson.com)
# License terms: GNU General Public License (GPL) version 2
#

# Trursted Execution Environment Configuration
config TEE_SUPPORT
	bool "Trusted Execution Environment Support"
	default y
	---help---
		This enables the Trusted Execution Environment (TEE) support.
```

## drivers/video/av8100/Kconfig
```kconfig
config AV8100
       tristate "AV8100 driver support(HDMI/CVBS)"
       default n
       help
           Please enable this feature if hdmi/tvout driver support is required.
```

## drivers/video/b2r2/Kconfig
```kconfig
config FB_B2R2
	tristate "B2R2 engine support"
	default y
	select FB_NDK_B2R2
	help
	  B2R2 engine does various bit-blitting operations,post-processor operations
	  and various compositions.

# Remove below as soon as CONFIG_FB_NDK_B2R2 is removed from the code
config FB_NDK_B2R2
	tristate
	depends on FB_B2R2
```

## drivers/video/mcde/Kconfig
```kconfig
config FB_MCDE
	tristate "MCDE support"
	depends on FB
	select FB_SYS_FILLRECT
	select FB_SYS_COPYAREA
	select FB_SYS_IMAGEBLIT
	select FB_SYS_FOPS
	---help---
	  This enables support for MCDE based frame buffer driver.

	  Please read the file <file:Documentation/fb/mcde.txt>

config MCDE_DISPLAY_GENERIC_DSI
	tristate "Generic display driver"
	depends on FB_MCDE

config MCDE_DISPLAY_AV8100
	tristate "AV8100 HDMI/CVBS display driver"
	depends on FB_MCDE
	select AV8100

config MCDE_DISPLAY_AB8500_DENC
	tristate "AB8500 CVBS display driver"
	depends on FB_MCDE
	select AB8500_DENC

config FB_MCDE_DEBUG
	bool "MCDE debug messages"
	depends on FB_MCDE
	---help---
	  Say Y here if you want the MCDE driver to output debug messages

config FB_MCDE_VDEBUG
	bool "MCDE verbose debug messages"
	depends on FB_MCDE_DEBUG
	---help---
	  Say Y here if you want the MCDE driver to output more debug messages
```

## net/caif/Kconfig
```kconfig
#
# CAIF net configurations
#

#menu "CAIF Support"
comment "CAIF Support"
menuconfig CAIF
	tristate "Enable CAIF support"
	select CRC_CCITT
	default n
	---help---
	The "Communication CPU to Application CPU Interface" (CAIF) is a packet
	based connection-oriented MUX protocol developed by ST-Ericsson for use
	with its modems.

	Say Y (or M) here if you build for a phone product (e.g. Android) that
	uses CAIF as transport, if unsure say N.

	If you select to build it as module then CAIF_SOCK and CAIF_NETDEV also
	needs to be built as modules. You will also need to say yes to any CAIF
	physical devices that your platform requires.

	See Documentation/networking/caif for a further explanation on how to
	use and configure CAIF.

if CAIF

config  CAIF_DEBUG
	bool "Enable Debug"
	default n
	--- help ---
	Enable the inclusion of debug code in the CAIF stack.
	Be aware that doing this will impact performance.
	If unsure say N.

config CAIF_SOCK
	tristate "CAIF Sockets"
	default CAIF
	---help---
	Say Y if you will be using CAIF Sockets.
	This can be either built-in or a loadable module,
	If you select to build it as a built-in then the main CAIF device must
	also be a built-in,
	If unsure say Y.

config CAIF_NETDEV
	tristate "CAIF GPRS Network device"
	default CAIF
	---help---
	Say Y if you will be using a CAIF based GPRS network device.
	This can be either built-in or a loadable module,
	If you select to build it as a built-in then the main CAIF device must
	also be a built-in.
	If unsure say Y.

#official-kernel-patch-cut-here

config CAIF_CHARDEV
	tristate "CAIF character device"
	default CAIF
	---help---
	Say Y if you will be using the CAIF AT type character devices.
	This can be either built-in or a loadable module,
	If you select to build it as a built-in then the main CAIF device must
	also be a built-in.
	If unsure say Y.

# Include physical drivers
source "drivers/net/caif/Kconfig"
#official-kernel-patch-resume-here
endif
#endmenu
```

## sound/soc/u8500/Kconfig
```kconfig
#
# U8500 SoC audio configuration
#

config SND_SOC_U8500
	bool "U8500"
	depends on SND_SOC
	default y
	help
	  Support for sound devices specific to ARM architectures.
	  Drivers that are implemented on ASoC can be found in
	  "ALSA for SoC audio support" section.
```

## sound/soc/ux500/Kconfig
```kconfig
#
# Ux500 SoC audio configuration
#

config SND_SOC_UX500
	bool "ux500"
	depends on SND_SOC && STM_I2S && STM_MSP_I2S
	default y
	help
	  Say Y if you want to add support for the codecs attached to
	  the I2S of the ux500. You will also need
	  to select the audio codecs to support below.

config SND_SOC_UX500_AB3550
	tristate "SoC Audio support for ux500 w break-out card AB3550"
	depends on SND_SOC_UX500 && AB3550_CORE
	select SND_SOC_AB3550
  help
	  Say Y if you want to add support for SoC audio on ux500 w break-out card AB3550.

config SND_SOC_UX500_CG29XX
	tristate "SoC Audio support for ux500 w break-out card CG29xx"
	depends on SND_SOC_UX500 && !SND_SOC_UX500_AB3550
	select SND_SOC_CG29XX
	help
	  Say Y if you want to add support for SoC audio on ux500 w break-out card CG29XX.
```
